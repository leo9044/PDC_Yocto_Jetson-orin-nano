## layers/meta-middleware/conf/layer.conf
```bitbake
# Layer configuration for meta-middleware
# This layer provides communication middleware (SOME/IP, CommonAPI) for automotive ECUs
BBPATH .= ":${LAYERDIR}"

# We have a conf and classes directory, add to BBPATH
BBPATH .= ":${LAYERDIR}"

# We have recipe directories, add to BBFILES
BBFILES += "${LAYERDIR}/recipes-*/*/*.bb \
            ${LAYERDIR}/recipes-*/*/*.bbappend"

# Layer identification and priority
BBFILE_COLLECTIONS += "meta-middleware"
BBFILE_PATTERN_meta-middleware = "^${LAYERDIR}/"

# Priority set to 10 (standard middleware layer)
BBFILE_PRIORITY_meta-middleware = "10"

# Layer dependencies
LAYERDEPENDS_meta-middleware = "core"

# Yocto series compatibility
LAYERSERIES_COMPAT_meta-middleware = "scarthgap"
```
